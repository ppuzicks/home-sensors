## home_mesh_app/boards/xtensa/esp32_devkit_v1/Kconfig.board
```kconfig
# SPDX-License-Identifier: MIT

config BOARD_ESP32_DEVKIT_V1
  bool "ESP32 DEVKIT V1 Board"
  depends on SOC_ESP32
```

## home_mesh_app/boards/xtensa/esp32_devkit_v1/Kconfig.defconfig
```kconfig
# ESP32 DEVKIT V1

config BOARD
  default "esp32_devkit_v1"
  depends on BOARD_ESP32_DEVKIT_V1

config ENTROPY_ESP32_RNG
  default y if ENTROPY_GENERATOR

if BT

config HEAP_MEM_POOL_SIZE
  default 16384

config ENTROPY_GENERATOR
  default y

choice BT_HCI_BUS_TYPE
  default BT_ESP32
endchoice

endif # BT
```

## manifest-repo/west.yml
```yaml
manifest:
  defaults:
    remote: zephyrproject-rtos

  remotes:
    - name: zephyrproject-rtos
      url-base: https://github.com/zephyrproject-rtos
    - name: mcuboot-repo
      url-base: https://github.com/JuulLabs-OSS/

  projects:
    - name: zephyr
      revision: v3.0.0
      import: true
```
